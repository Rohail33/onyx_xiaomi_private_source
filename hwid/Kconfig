## mi_schedule/Kconfig
```kconfig
# Kconfig for Xiaomi MI Scheduler Module
# drivers/mihw/mi_sched/Kconfig

menuconfig MI_SCHED
	tristate "Xiaomi MI Scheduler (MI-SCHED)"
	depends on SMP && ARM64
	default m
	help
	  Enable Xiaomi MI Scheduler for heterogeneous multi-core CPU optimization.

	  The MI Scheduler is a custom process scheduling system that optimizes
	  performance on devices with heterogeneous CPU clusters (little cores,
	  big cores, etc.). It provides:

	  - Per-application performance tuning
	  - Foreground/background task distinction
	  - FPS-aware scheduling for UI applications
	  - Real-time CPU cluster load monitoring
	  - Dynamic task migration between CPU clusters
	  - Frame load prediction and optimization

	  This module integrates with the Linux kernel scheduler and provides
	  additional intelligence for heterogeneous multi-core processors.

	  If unsure, say M (compile as module).

if MI_SCHED

config MI_SCHED_DEBUG
	bool "Enable MI Scheduler debugging"
	default n
	help
	  Enable debug output and verbose logging from the MI Scheduler module.
	  This will print additional information to the kernel log for debugging
	  and analysis purposes.

	  Debug messages use the prefix "6mi_group:" and "3mi_sched:".

	  If unsure, say N.

config MI_SCHED_DEVELOP_MODE
	bool "Enable development mode support"
	default y
	help
	  Enable development mode in MI Scheduler for detailed analysis and
	  debugging. This allows toggling development mode via procfs at runtime.

	  Development mode provides:
	  - Enhanced debug output
	  - Detailed statistics collection
	  - Trace window functionality
	  - Pause mode for scheduler analysis

	  If unsure, say Y.

config MI_SCHED_PROC_FS
	bool "Procfs interface for MI Scheduler"
	depends on PROC_FS
	default y
	help
	  Create /proc/mi_sched/ directory with interface files for monitoring
	  and configuring the MI Scheduler at runtime.

	  Procfs interface provides:
	  - /proc/mi_sched/top_package - Top packages by CPU usage
	  - /proc/mi_sched/trace_stat - Trace statistics
	  - /proc/mi_sched/window_size - Runtime window configuration
	  - /proc/mi_sched/traced_window - Detailed trace data
	  - /proc/mi_sched/runtime - Per-package runtime statistics
	  - /proc/mi_sched/develop_mode - Development mode toggle
	  - /proc/mi_sched/pause_mode - Pause mode toggle

	  If unsure, say Y.

config MI_SCHED_DEVICE_INTERFACE
	bool "Device interface for MI Scheduler"
	default y
	help
	  Create /dev/mi_group device for ioctl-based control and configuration
	  of the MI Scheduler.

	  Device interface provides:
	  - MI_SCHED_IOC_QUERY_GROUP - Query group information
	  - MI_SCHED_IOC_CHANGE_FPS - Change FPS target
	  - MI_SCHED_IOC_CHANGE_APP_STATUS - Update application status
	  - MI_SCHED_IOC_RESET_WINDOW - Reset statistics window
	  - Memory mapping for shared statistics

	  If unsure, say Y.

config MI_SCHED_NUM_CLUSTERS
	int "Number of CPU clusters"
	range 1 4
	default 4
	help
	  Configure the number of heterogeneous CPU clusters on the device.

	  Typical configurations:
	  - 2: Little clusters + Big cluster
	  - 3: Little + Big 1 + Big 2
	  - 4: Little + Big 1 + Big 2 + Super (premium devices)

	  This value can be updated at runtime via module parameter.

config MI_SCHED_LS_GRP_PREFER_CID
	int "Preferred cluster ID for LS groups"
	range 0 3
	default 0
	help
	  Set the default preferred cluster ID for Little/Small (LS) groups.

	  Cluster IDs:
	  - 0: Little cores (low power, default)
	  - 1: Big cores cluster 1 (mid-performance)
	  - 2: Big cores cluster 2 (high-performance)
	  - 3: Super cores (ultra-performance, if available)

	  This setting affects task placement for background applications.

config MI_SCHED_TARGET_MAKEUP_NS
	int "Target makeup time in nanoseconds"
	range 0 10000000000
	default 0
	help
	  Configure the target makeup time for frame deadline achievement.

	  Makeup time is the additional time allowed for a task to meet its
	  frame deadline. This is useful for ensuring consistent frame rates
	  in latency-sensitive applications.

	  Value in nanoseconds (0 = disabled, default).
	  Example: 1000000000 = 1 second

config MI_SCHED_MAX_USERS
	int "Maximum concurrent users"
	range 100 10000
	default 1000
	help
	  Configure the maximum number of concurrent users that can be tracked
	  by the MI Scheduler.

	  Each user (UID) gets its own scheduler metadata structure. Increasing
	  this value increases memory usage.

config MI_SCHED_MAX_GROUPS
	int "Maximum scheduler groups"
	range 16 1024
	default 256
	help
	  Configure the maximum number of process groups that can be managed
	  by the MI Scheduler.

	  Each group represents a set of related tasks with shared scheduling
	  policy. Increasing this value increases memory usage.

config MI_SCHED_WORKQUEUE
	bool "Use workqueue for async operations"
	default y
	help
	  Use kernel workqueue for asynchronous MI Scheduler operations.
	  This offloads certain scheduling decisions to a dedicated worker thread.

	  If unsure, say Y.

config MI_SCHED_STATISTICS
	bool "Comprehensive statistics collection"
	default y
	help
	  Enable collection of detailed statistics about task scheduling,
	  group transitions, and CPU cluster usage.

	  Statistics are available via:
	  - /proc/mi_sched/trace_stat
	  - /proc/mi_sched/runtime
	  - Device ioctl queries

	  Enabling statistics has minimal performance impact (~1-2%).

config MI_SCHED_FRAME_TRACKING
	bool "Frame load tracking for UI optimization"
	default y
	help
	  Enable frame load tracking for optimizing UI applications.

	  Frame tracking monitors frame completion time and predicts frame load
	  for better scheduling decisions. This is particularly useful for
	  maintaining consistent frame rates in display-intensive applications.

	  Typical frame rates: 30 Hz, 60 Hz, 90 Hz, 120 Hz

config MI_SCHED_RAVG_TRACKING
	bool "Running average tracking"
	default y
	help
	  Enable running average (RAVG) tracking for CPU utilization prediction.

	  RAVG provides historical data for better load prediction and helps
	  the scheduler make more informed decisions about task placement.

config MI_SCHED_LOAD_HOOKS
	bool "Enable scheduler load update hooks"
	default y
	help
	  Register hooks into the kernel scheduler for real-time load updates.

	  This allows the MI Scheduler to react to kernel scheduler events
	  and adjust scheduling decisions accordingly.

	  If unsure, say Y.

config MI_SCHED_OPTIMIZE_FOREGROUND
	bool "Optimize foreground applications"
	default y
	help
	  Apply special optimization for foreground (interactive) applications.

	  Foreground optimization includes:
	  - Priority boost for UI tasks
	  - Preferred placement on big cores
	  - Lower latency for touch response
	  - FPS-aware scheduling

	  If unsure, say Y.

config MI_SCHED_OPTIMIZE_BACKGROUND
	bool "Optimize background applications"
	default y
	help
	  Apply optimization for background applications.

	  Background optimization includes:
	  - Lower priority scheduling
	  - Preferred placement on little cores
	  - Power-efficient execution
	  - Reduced frequency scaling

	  If unsure, say Y.

config MI_SCHED_POWER_EFFICIENCY
	bool "Power efficiency optimization"
	default y
	help
	  Enable power efficiency optimization in task scheduling.

	  This optimizes for lower power consumption while maintaining
	  acceptable performance for background tasks.

	  If unsure, say Y.

config MI_SCHED_THERMAL_CONTROL
	bool "Thermal-aware scheduling"
	default n
	help
	  Enable thermal-aware scheduling to prevent thermal throttling
	  by distributing load more evenly across CPU clusters.

	  Note: This requires additional integration with the thermal subsystem.

endif # MI_SCHED
```

## mi_thermal/Kconfig
```kconfig
config MI_THERMAL_INTERFACE
	tristate "Xiaomi thermal control interface"
	depends on CPU_FREQ
	depends on PM
	help
	  Reconstructed Xiaomi thermal userspace interface.  This module
	  provides thermal-message and mi_powersave sysfs nodes, CPU max
	  frequency QoS control through cpu_limits, USB online notification,
	  screen state notification hooks, and Xiaomi thermal switch state
	  integration.

	  The reconstructed ABI is based on mi_thermal_interface.ko symbols:
	  temp_state, cpu_limits, sconfig, screen_state, boost,
	  board_sensor_temp, modem/wifi/ntn limits, powersave_mode and
	  power_level.

config MI_THERMAL_INTERFACE_XIAOMI_HOOKS
	bool "Enable Xiaomi MCA and panel notifier hooks"
	depends on MI_THERMAL_INTERFACE
	default y
	help
	  Enable integration with Xiaomi-only symbols:
	  mca_smartchg_set_scene, mca_event_block_notify,
	  panel_event_notifier_register and panel_event_notifier_unregister.

	  Disable this option when building on a generic kernel tree that does
	  not provide Xiaomi MCA/panel notifier modules.
```

## miev/Kconfig
```kconfig
config XIAOMI_MIEV
	tristate "Xiaomi MIEV exception event transport"
	help
	  Build the Xiaomi MIEV exception/event transport module.
	  The driver creates /dev/miev and exports the cdev_tevent_* helper
	  ABI used by Xiaomi vendor modules to submit structured diagnostic
	  events.
	  Exported symbols:
	    cdev_tevent_alloc
	    cdev_tevent_add_int
	    cdev_tevent_add_str
	    cdev_tevent_write
	    cdev_tevent_destroy
	  If unsure, say M when building Xiaomi vendor touch/thermal modules
	  that depend on miev.ko.
```

## migt/Kconfig
```kconfig
config XIAOMI_MIGT
	tristate "Xiaomi MIGT performance framework"
	help
	  Xiaomi MIGT is a vendor performance framework used for frame-aware
	  boosting, game/load classification, FLT/GLK tuning, and related
	  scheduler hooks.

	  This is a reverse-engineered compatibility layer. Enable it only if
	  your tree also provides the Xiaomi WALT/Metis/MIST hook surface or the
	  matching companion modules.
```

## miloadtrace/Kconfig
```kconfig
# SPDX-License-Identifier: GPL-2.0
config XIAOMI_MILOADTRACE
	tristate "Xiaomi frame-load trace and Mi governor"
	depends on SMP && CPU_FREQ
	select MISC_DEVICES
	select PROC_FS
	help
	  Reconstructed Xiaomi miloadtrace module.
	  The vendor module provides frame-load accounting hooks, /proc/miload
	  controls, the mi_frameload misc device, and a small cpufreq governor
	  registration surface used together with mi_schedule, sched-walt, and
	  metis.
	  This reconstruction preserves the recovered ABI while keeping runtime
	  policy conservative for bring-up.
```

## mist/Kconfig
```kconfig
# MIST (Memory Intensive Scheduler Tuning) Configuration
# Xiaomi Performance Optimization Module

config MIST_SCHEDULER
	tristate "MIST - Memory Intensive Scheduler Tuning"
	depends on SMP && ARM64 && CPU_FREQ
	default m
	help
	  Enable MIST for advanced memory latency and bandwidth optimization.
	  
	  MIST (Memory Intensive Scheduler Tuning) provides:
	  - Memory latency monitoring and optimization
	  - Bandwidth-aware frequency scaling
	  - GPU-aware performance tuning
	  - DDR frequency coordination
	  - Frame-based performance tracking
	  - Performance counter collection
	  
	  This module is particularly beneficial for:
	  - Mobile gaming and multimedia apps
	  - High-performance computing workloads
	  - Memory-intensive applications
	  - Systems with GPU acceleration
	  
	  If unsure, say M (compile as module).

if MIST_SCHEDULER

config MIST_DEBUG
	bool "MIST Debug Output"
	default n
	help
	  Enable verbose debug output for MIST operations.
	  Useful for development and troubleshooting.

config MIST_FTRACE_DEBUG
	bool "MIST Ftrace Debugging"
	default n
	help
	  Enable kernel tracepoints for MIST performance analysis.

config MIST_LATENCY_MONITOR
	bool "MIST Latency Monitoring"
	default y
	help
	  Enable memory latency monitoring and optimization.

config MIST_BANDWIDTH_MONITOR
	bool "MIST Bandwidth Monitoring"
	default y
	help
	  Enable bandwidth monitoring and dynamic adjustment.

config MIST_GPU_FLT
	bool "MIST GPU Frequency Latency Tracking"
	default y
	help
	  Enable GPU frequency latency tracking for optimal performance.

config MIST_FREQUENCY_SCALING
	bool "MIST Frequency Scaling Integration"
	default y
	help
	  Integrate MIST with CPU frequency scaling (cpufreq).

config MIST_DDR_OPTIMIZATION
	bool "MIST DDR Frequency Optimization"
	default y
	help
	  Enable DDR frequency optimization based on memory access patterns.

config MIST_FRAME_TRACKING
	bool "MIST Frame-based Performance Tracking"
	default y
	help
	  Enable frame-based performance tracking for game optimization.

config MIST_MAX_DDR_IB
	int "Maximum DDR Instantaneous Bandwidth (MB/s)"
	default 4000
	range 1000 10000
	help
	  Maximum DDR bandwidth to consider for frequency scaling.

config MIST_SPM_THRESHOLD
	int "Stall Percentage Threshold (%)"
	default 75
	range 10 100
	help
	  Stall percentage threshold for triggering frequency adjustments.

config MIST_IPS_THRESHOLD
	int "Instructions Per Second Threshold"
	default 2000
	range 100 10000
	help
	  IPS threshold for performance-based frequency decisions.

config MIST_STALLRATIO_THRESHOLD
	int "Stall Ratio Threshold"
	default 60
	range 0 100
	help
	  Threshold for stall ratio-based frequency scaling decisions.

endif # MIST_SCHEDULER
```

## perf_helper/Kconfig
```kconfig
# SPDX-License-Identifier: GPL-2.0

config XIAOMI_PERF_HELPER
	tristate "Xiaomi perf helper"
	depends on PROC_FS && SYSFS
	help
	  Reconstructed Xiaomi perf_helper module.

	  The original vendor module exposes perflock, MIMD reclaim, and scheduler
	  assistance interfaces and depends on sched-walt. This reconstruction
	  preserves the visible ABI and user-facing nodes while keeping recovered
	  runtime policy conservative.
```
